#include <LiquidCrystal.h>
#include <Keypad.h>
#include  <Wire.h>
#include <SeeedOLED.h>
#include  "rgb_lcd.h"
#include "DHT.h"
#define DHTPIN 8
#define DHTTYPE DHT22

rgb_lcd  lcd;

//Partie Corentin
char Clavier[5];
int compteur = 0;
int N;
int M1 = 2;            
int code;
const byte ROWS = 4; 
const byte COLS = 3;
const int C3=11; 
const int C2=13; 
const int C1=15; 
const int L4=3;
const int L3=5;
const int L2=7; 
const int L1=9; 
char keys[ROWS][COLS] = {
  {'1','2','3'},
  {'4','5','6'},
  {'7','8','9'},
  {'*','0','#'}
};
byte rowPins[ROWS] = { 9, 7, 5, 3}; 
byte colPins[COLS] = {15, 13, 11}; 
Keypad keypad = Keypad( makeKeymap(keys), rowPins, colPins, ROWS, COLS );
char key;

//Partie Alexis
DHT dht(DHTPIN, DHTTYPE);

//partie Jonathan
int RELAY = 14;
int RELAY2 = 18;
int SmokeSensor = A2;
int SmokeSensorVal = 0;

int dangercheck = 500;

static const unsigned char SeeedLogo[] PROGMEM = {
    0xff, 0xff, 0xff, 0xff, 0xff, 0xff, 0xff, 0xff, 0xff, 0xff, 0xff, 0xff, 0xff, 0xff, 0xff, 0xff, 
  0xff, 0xff, 0xff, 0xff, 0xff, 0xff, 0xff, 0xff, 0xff, 0xff, 0xff, 0xff, 0xff, 0xff, 0xff, 0xff, 
  0xff, 0xff, 0xff, 0xff, 0xff, 0xff, 0xff, 0xff, 0xff, 0xff, 0xff, 0xff, 0xff, 0xff, 0xff, 0xff, 
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  0xff, 0xff, 0xff, 0xff, 0xff, 0xff, 0xff, 0xff, 0xff, 0xff, 0xff, 0xff, 0xff, 0xff, 0xff, 0xff
};

void setup(){
   Wire.begin();
   SeeedOled.init();
   SeeedOled.clearDisplay();
   SeeedOled.setNormalDisplay();
   SeeedOled.setPageMode();
   SeeedOled.drawBitmap((unsigned char*) SeeedLogo, 1024);

   
   lcd.begin(16, 2);
   lcd.setRGB(0, 0, 220);

//Partie Corentin
 pinMode(M1, OUTPUT);    
   
//Partie Alexis
dht.begin();
   
pinMode(4,OUTPUT);
pinMode(6,OUTPUT);
pinMode(10,OUTPUT);
pinMode(12,OUTPUT);

//Partie Jonathan
pinMode(RELAY, OUTPUT); // Relay
pinMode(RELAY2, OUTPUT); // Relay2
pinMode(SmokeSensor, INPUT); // SmokeSensor
}
  
void loop(){
   Corentin();
}

//Jonathan
void Jonathan() {
      SmokeSensorVal = analogRead(SmokeSensor);

      SeeedOled.setTextXY(0, 0);
      SeeedOled.putString("fumee :");
      SeeedOled.setTextXY(0, 8);
      SeeedOled.putNumber(SmokeSensorVal);

      if(SmokeSensorVal > dangercheck) {
   JonathanAff(false);
      } else {
   JonathanAff(true);
      }
}

void JonathanAff(boolean etat) {
      if(etat == true) {
   digitalWrite(RELAY, LOW);
   digitalWrite(RELAY2, LOW);
      } else {
   SeeedOled.setTextXY(1, 0);
   SeeedOled.putString("Fumee Detectee");
   digitalWrite(RELAY, HIGH);
   digitalWrite(RELAY2, HIGH);
      }
 }
 
 //Alexis
 void AlexisHumi() {
   float humi = dht.readHumidity();
 
   if (humi>47.5) { digitalWrite(4,HIGH); }
   if (humi<45) { digitalWrite(4,LOW); }
   if (humi>35) { digitalWrite(6,LOW); }
   if (humi<32.5) { digitalWrite(6,HIGH); }

   SeeedOled.setTextXY(3, 0);
   SeeedOled.putString("humi :   ");   
   SeeedOled.setTextXY(3, 8);
   SeeedOled.putFloat(humi);
 }
 
 void AlexisTemp() {
   float temp = dht.readTemperature();
   
   if (temp<25) { digitalWrite(10,HIGH); }
   if (temp>26) { digitalWrite(10,LOW); }
   if (temp>27) { digitalWrite(12,HIGH); }
   if (temp<25.5) { digitalWrite(12,LOW); }
   
   SeeedOled.setTextXY(4, 0);
   SeeedOled.putString("temp :    ");
   SeeedOled.setTextXY(4, 8);
   SeeedOled.putFloat(temp);
 }
 
 //Corentin
 void Corentin() {   
   while(N != 4) {    
      lcd.setCursor(0, 0);
      lcd.print("Code:");  
      key = keypad.getKey();
      if (key){ 
        if(key != '#') {
          CorentinCheck();
        } else {
          Affichage();
        }
      }
   }
   lcd.setCursor(0, 0);
   if (code == 3894 ){
      lcd.print("Code Correct          ");
      digitalWrite(M1,HIGH);
      lcd.setRGB(0, 255, 0);
      delay(5000);
      lcd.setRGB(0, 0, 220);
      digitalWrite(M1,LOW);
      CorentinReset();
   }else{
      lcd.print("Code Incorrect         ");
      lcd.setRGB(255, 0, 0);
      delay(1000);
      lcd.setRGB(0, 0, 220);
      CorentinReset();
   }
 }
 
 void CorentinCheck() {
      Clavier[compteur++]= key;
      Clavier[compteur]= '\0';
      code= atoi(Clavier);  
      lcd.setCursor(8, 0);
      lcd.print("*");
      delay(100);
      N=1+N; 
 }
 
 void CorentinReset() {
   delay(500);
   lcd.setCursor(0, 0);
   lcd.print("              ");
   N=0; 
   compteur =0;
   delay(1000);
   Corentin();
 }

 void Affichage() {
  SeeedOled.clearDisplay();
  Jonathan();
  AlexisHumi();
  AlexisTemp();
 }

